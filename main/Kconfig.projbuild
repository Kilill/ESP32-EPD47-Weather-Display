## main/Kconfig.projbuild
```kconfig
menu "Weather Station Configuration"

    config WIFI_SSID
        string "WiFi SSID"
        default "myssid"
        help
            SSID (network name) for the weather station to connect to.

    config WIFI_PASSWORD
        string "WiFi Password"
        default "mypassword"
        help
            WiFi password (WPA or WPA2) for the weather station to use.

    config MQTT_BROKER_URI
        string "MQTT Broker URI"
        default "mqtt://broker.example.com:1883"
        help
            URI of the MQTT broker to connect to.

    config MQTT_USERNAME
        string "MQTT Username"
        default ""
        help
            Username for MQTT broker authentication (leave empty if not required).

    config MQTT_PASSWORD
        string "MQTT Password"
        default ""
        help
            Password for MQTT broker authentication (leave empty if not required).

    config MQTT_WEATHER_TOPIC
        string "MQTT Weather Data Topic"
        default "weather/realtime"
        help
            MQTT topic to subscribe to for realtime weather data.

    config WEBSERVER_URL
        string "Historical Data Webserver URL"
        default "http://weather.example.com/api/history"
        help
            URL of the webserver providing historical weather data.

    config UPDATE_INTERVAL_MINUTES
        int "Display Update Interval (minutes)"
        default 5
        range 1 60
        help
            Interval between display updates in minutes (for E-ink display).

endmenu
```
